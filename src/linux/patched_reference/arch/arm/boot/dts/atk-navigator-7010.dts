/*
 * CAUTION: This file is automatically generated by Xilinx.
 * Version: XSCT 
 * Today is: Tue Feb  7 07:45:02 2023
 */


/dts-v1/;
#include "zynq-7000.dtsi"
#include "navigator-7010-pcw.dtsi"
#include "navigator-7010-pl.dtsi"
/ {
	chosen {
		bootargs = "console=ttyPS0,115200 cma=50M earlycon root=/dev/mmcblk0p2 rw rootwait";
		stdout-path = "serial0:115200n8";
	};
	aliases {
		ethernet0 = &gem0;
		ethernet1 = &gem1;
		i2c0 = &i2c0;
		i2c1 = &i2c1;
		i2c2 = &i2c2;
		serial0 = &uart0;
		serial1 = &uart1;
		spi0 = &qspi;
	};
	memory {
		device_type = "memory";
		reg = <0x0 0x20000000>;
	};
};
#define Z7010
#include "navigator-system-user.dtsi"
#include "labmate-spi-board.dtsi"
